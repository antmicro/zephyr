## CMakeLists.txt
```
# Copyright (c) 2026 Antmicro <www.antmicro.com>
# SPDX-License-Identifier: Apache-2.0

cmake_minimum_required(VERSION 3.20.0)
find_package(Zephyr REQUIRED HINTS $ENV{ZEPHYR_BASE})
project(host-hid-boot)

FILE(GLOB app_sources src/*.c)
target_sources(app PRIVATE ${app_sources})
```

## sample.yaml
```
sample:
  name: USB support shell sample
tests:
  sample.usbh.hid.log:
    tags:
      - usb
      - shield
    extra_args:
      - SHIELD="sparkfun_max3421e"
    platform_allow:
      - stm32h747i_disco/stm32h747xx/m7
    build_only: true
  sample.usbh.hid.log.virtual:
    tags: usb
    platform_allow: qemu_cortex_m3
    build_only: true
```

## prj.conf
```kconfig
# Copyright (c) 2026 Antmicro <www.antmicro.com>

CONFIG_SAMPLE_COLORED_OUTPUT=y

CONFIG_SHELL=y
CONFIG_SHELL_BACKEND_SERIAL=y
CONFIG_SHELL_PROMPT_UART=""
CONFIG_SHELL_ECHO_STATUS=n
CONFIG_SHELL_VT100_COLORS=y

CONFIG_USB_HOST_STACK=y
CONFIG_USBH_STACK_SIZE=2048

CONFIG_INPUT=y
CONFIG_INPUT_MODE_THREAD=y

CONFIG_ASSERT=y
CONFIG_ASSERT_LEVEL=2

CONFIG_USBH_HID_BOOT_CLASS=y
CONFIG_USBH_HID_BOOT_INSTANCES_COUNT=1

CONFIG_LOG=y
CONFIG_LOG_BUFFER_SIZE=4096
```

## boards/qemu_cortex_m3.conf
```kconfig
# Copyright (c) 2026 Antmicro <www.antmicro.com>
# SPDX-License-Identifier: Apache-2.0

CONFIG_UHC_DRIVER=y
CONFIG_USB_HOST_STACK=y
```

## virtual.overlay
```dts
/*
 * Copyright (c) 2026 Antmicro <www.antmicro.com>
 *
 * SPDX-License-Identifier: Apache-2.0
 */

/delete-node/ &zephyr_udc0;

/ {
	zephyr_uhc0: uhc_vrt0 {
		compatible = "zephyr,uhc-virtual";

		zephyr_udc0: udc_vrt0 {
			compatible = "zephyr,udc-virtual";
			num-bidir-endpoints = <8>;
			maximum-speed = "high-speed";
		};

		udc1: udc_vrt1 {
			compatible = "zephyr,udc-virtual";
			num-bidir-endpoints = <8>;
			maximum-speed = "full-speed";
		};
	};
};
```

## boards/qemu_cortex_m3.overlay
```dts
/*
 * Copyright (c) 2026 Antmicro <www.antmicro.com>
 *
 * SPDX-License-Identifier: Apache-2.0
 */

/ {
	zephyr_uhc0: uhc_vrt0 {
		compatible = "zephyr,uhc-virtual";

		zephyr_udc0: udc_vrt0 {
			compatible = "zephyr,udc-virtual";
			num-bidir-endpoints = <8>;
			maximum-speed = "high-speed";
		};

		udc1: udc_vrt1 {
			compatible = "zephyr,udc-virtual";
			num-bidir-endpoints = <8>;
			maximum-speed = "full-speed";
		};
	};
};
```

## src/main.c
```c
/*
 * Copyright (c) 2024 Antmicro <www.antmicro.com>
 *
 * SPDX-License-Identifier: Apache-2.0
 */

#include <zephyr/kernel.h>
#include <zephyr/logging/log.h>
#include <zephyr/input/input.h>
#include <zephyr/usb/usbh.h>

#include "keys.h"

#define ANSI_COLOR_GREEN "\x1b[92m"
#define ANSI_COLOR_RESET "\x1b[0m"

#ifdef CONFIG_SAMPLE_COLORED_OUTPUT
#define HIGHLIGHT(text) ANSI_COLOR_GREEN text ANSI_COLOR_RESET
#else
#define HIGHLIGHT(text) text
#endif

LOG_MODULE_REGISTER(main, LOG_LEVEL_DBG);

USBH_CONTROLLER_DEFINE(uhs_ctx, DEVICE_DT_GET(DT_NODELABEL(zephyr_uhc0)));

static const struct device *usbh_hid_dev;

static const char *input_to_key_name(uint16_t key_code)
{
	if (key_code >= ARRAY_SIZE(input_to_key_name_map)) {
		return 0;
	}
	return input_to_key_name_map[key_code];
}

static void mouse_evt_handler(struct input_event *evt)
{
	switch (evt->code) {
	case INPUT_BTN_LEFT:
		LOG_INF(HIGHLIGHT("Left") " button " HIGHLIGHT("%s"),
			evt->value ? "pressed" : "let go");
		break;
	case INPUT_BTN_MIDDLE:
		LOG_INF(HIGHLIGHT("Middle") " button " HIGHLIGHT("%s"),
			evt->value ? "pressed" : "let go");
		break;
	case INPUT_BTN_RIGHT:
		LOG_INF(HIGHLIGHT("Right") " button " HIGHLIGHT("%s"),
			evt->value ? "pressed" : "let go");
		break;
	case INPUT_REL_X:
	case INPUT_REL_Y:
		LOG_INF("Mouse moved in " HIGHLIGHT("%c") " axis by " HIGHLIGHT("%d"),
			evt->code == INPUT_REL_X ? 'X' : 'Y', evt->value);
		break;
	}
}

static void kbd_evt_handler(struct input_event *evt)
{
	const char *name = input_to_key_name(evt->code);

	if (name) {
		LOG_INF("Key " HIGHLIGHT("%s") " was " HIGHLIGHT("%s"), name,
			evt->value ? "pressed" : "released");
	}
}

static void input_cb(struct input_event *evt, void *user_data)
{
	ARG_UNUSED(user_data);

	/* Check if the event is from the desired device */
	if (evt->dev != usbh_hid_dev) {
		return;
	}

	if (evt->type == INPUT_EV_REL || evt->code == INPUT_BTN_LEFT ||
	    evt->code == INPUT_BTN_MIDDLE || evt->code == INPUT_BTN_RIGHT) {
		mouse_evt_handler(evt);
	} else {
		kbd_evt_handler(evt);
	}
}
INPUT_CALLBACK_DEFINE(NULL, input_cb, NULL);

int main(void)
{
	int err;

	/*
	 * HID Boot devices are named:
	 * usbh_hid_boot_0,
	 * usbh_hid_boot_1,
	 * ...,
	 * usbh_hid_boot_(CONFIG_USBH_HID_BOOT_INSTANCES_COUNT-1)
	 */
	usbh_hid_dev = device_get_binding("usbh_hid_boot_0");

	err = usbh_init(&uhs_ctx);
	if (err == -EALREADY) {
		LOG_ERR("host: USB host already initialized");
	} else if (err) {
		LOG_ERR("host: Failed to initialize %d", err);
	} else {
		LOG_INF("host: USB host initialized");
	}

	return 0;
}
```

## src/keys.h
```c
/*
 * Copyright (c) 2024 Antmicro <www.antmicro.com>
 *
 * SPDX-License-Identifier: Apache-2.0
 */

#include <zephyr/input/input.h>

const char *const input_to_key_name_map[] = {
	[INPUT_KEY_A] = "A",
	[INPUT_KEY_B] = "B",
	[INPUT_KEY_C] = "C",
	[INPUT_KEY_D] = "D",
	[INPUT_KEY_E] = "E",
	[INPUT_KEY_F] = "F",
	[INPUT_KEY_G] = "G",
	[INPUT_KEY_H] = "H",
	[INPUT_KEY_I] = "I",
	[INPUT_KEY_J] = "J",
	[INPUT_KEY_K] = "K",
	[INPUT_KEY_L] = "L",
	[INPUT_KEY_M] = "M",
	[INPUT_KEY_N] = "N",
	[INPUT_KEY_O] = "O",
	[INPUT_KEY_P] = "P",
	[INPUT_KEY_Q] = "Q",
	[INPUT_KEY_R] = "R",
	[INPUT_KEY_S] = "S",
	[INPUT_KEY_T] = "T",
	[INPUT_KEY_U] = "U",
	[INPUT_KEY_V] = "V",
	[INPUT_KEY_W] = "W",
	[INPUT_KEY_X] = "X",
	[INPUT_KEY_Y] = "Y",
	[INPUT_KEY_Z] = "Z",

	[INPUT_KEY_1] = "1",
	[INPUT_KEY_2] = "2",
	[INPUT_KEY_3] = "3",
	[INPUT_KEY_4] = "4",
	[INPUT_KEY_5] = "5",
	[INPUT_KEY_6] = "6",
	[INPUT_KEY_7] = "7",
	[INPUT_KEY_8] = "8",
	[INPUT_KEY_9] = "9",
	[INPUT_KEY_0] = "0",

	[INPUT_KEY_ENTER] = "ENTER",
	[INPUT_KEY_ESC] = "ESC",
	[INPUT_KEY_BACKSPACE] = "BACKSPACE",
	[INPUT_KEY_TAB] = "TAB",

	[INPUT_KEY_SPACE] = "SPACE",
	[INPUT_KEY_MINUS] = "MINUS",
	[INPUT_KEY_EQUAL] = "EQUAL",
	[INPUT_KEY_LEFTBRACE] = "LEFTBRACE",
	[INPUT_KEY_RIGHTBRACE] = "RIGHTBRACE",
	[INPUT_KEY_BACKSLASH] = "BACKSLASH",
	[INPUT_KEY_SEMICOLON] = "SEMICOLON",
	[INPUT_KEY_APOSTROPHE] = "APOSTROPHE",
	[INPUT_KEY_GRAVE] = "GRAVE",
	[INPUT_KEY_COMMA] = "COMMA",
	[INPUT_KEY_DOT] = "DOT",
	[INPUT_KEY_SLASH] = "SLASH",
	[INPUT_KEY_CAPSLOCK] = "CAPSLOCK",

	[INPUT_KEY_F1] = "F1",
	[INPUT_KEY_F2] = "F2",
	[INPUT_KEY_F3] = "F3",
	[INPUT_KEY_F4] = "F4",
	[INPUT_KEY_F5] = "F5",
	[INPUT_KEY_F6] = "F6",
	[INPUT_KEY_F7] = "F7",
	[INPUT_KEY_F8] = "F8",
	[INPUT_KEY_F9] = "F9",
	[INPUT_KEY_F10] = "F10",
	[INPUT_KEY_F11] = "F11",
	[INPUT_KEY_F12] = "F12",

	[INPUT_KEY_SYSRQ] = "SYSRQ",
	[INPUT_KEY_SCROLLLOCK] = "SCROLLLOCK",
	[INPUT_KEY_PAUSE] = "PAUSE",
	[INPUT_KEY_INSERT] = "INSERT",
	[INPUT_KEY_HOME] = "HOME",
	[INPUT_KEY_PAGEUP] = "PAGEUP",
	[INPUT_KEY_DELETE] = "DELETE",
	[INPUT_KEY_END] = "END",
	[INPUT_KEY_PAGEDOWN] = "PAGEDOWN",

	[INPUT_KEY_RIGHT] = "RIGHT",
	[INPUT_KEY_LEFT] = "LEFT",
	[INPUT_KEY_DOWN] = "DOWN",
	[INPUT_KEY_UP] = "UP",

	[INPUT_KEY_NUMLOCK] = "NUMLOCK",
	[INPUT_KEY_KPSLASH] = "KEYPAD_SLASH",
	[INPUT_KEY_KPASTERISK] = "KEYPAD_ASTERISK",
	[INPUT_KEY_KPMINUS] = "KEYPAD_MINUS",
	[INPUT_KEY_KPPLUS] = "KEYPAD_PLUS",
	[INPUT_KEY_KPENTER] = "KEYPAD_ENTER",
	[INPUT_KEY_KP1] = "KEYPAD_1",
	[INPUT_KEY_KP2] = "KEYPAD_2",
	[INPUT_KEY_KP3] = "KEYPAD_3",
	[INPUT_KEY_KP4] = "KEYPAD_4",
	[INPUT_KEY_KP5] = "KEYPAD_5",
	[INPUT_KEY_KP6] = "KEYPAD_6",
	[INPUT_KEY_KP7] = "KEYPAD_7",
	[INPUT_KEY_KP8] = "KEYPAD_8",
	[INPUT_KEY_KP9] = "KEYPAD_9",
	[INPUT_KEY_KP0] = "KEYPAD_0",
	[INPUT_KEY_KPDOT] = "KEYPAD_DOT",
	[INPUT_KEY_MENU] = "Application/Menu Key",

	[INPUT_KEY_LEFTCTRL] = "Left Ctrl",
	[INPUT_KEY_LEFTSHIFT] = "Left Shift",
	[INPUT_KEY_LEFTALT] = "Left Alt",
	[INPUT_KEY_LEFTMETA] = "Left Meta",
	[INPUT_KEY_RIGHTCTRL] = "Right Ctrl",
	[INPUT_KEY_RIGHTSHIFT] = "Right Shift",
	[INPUT_KEY_RIGHTALT] = "Right Alt",
	[INPUT_KEY_RIGHTMETA] = "Right Meta",
};
```
