## drivers/display/Kconfig.adi_adv7535
```kconfig
# Copyright (c) 2026 Antmicro <www.antmicro.com>
#
# SPDX-License-Identifier: Apache-2.0

config ADI_ADV7535
	bool "Analog Devices ADV7535 DSI-to-HDMI bridge driver"
	default y
	select MIPI_DSI
	select I2C
	select GPIO
	depends on DT_HAS_ADI_ADV7535_ENABLED
	help
	  Enable driver for Analog Devices ADV7535 DSI-to-HDMI display bridge.
```

## dts/bindings/display/adi,adv7535.yaml
```yaml
#
# Copyright (c) 2026 Antmicro <www.antmicro.com>
#
# SPDX-License-Identifier: Apache-2.0
#

title: Analog Devices ADV7535 DSI-to-HDMI display bridge

description: |
    The ADV7535 provides a MIPI® display serial interface (MIPI/ DSI) input receiver and
    a High-Definition Multimedia Interface (HDMI®) transmitter output.
    The DSI receiver input supports DSI video mode operation only, and specifically,
    only supports non-burst mode with sync pulses.
    The DSI receiver provides up to four lanes of MIPI/DSI data, each running up to 891 Mbps.
    The HDMI transmitter supports video resolutions up to a maximum TMDS clock frequency
    of 148.5 MHz. The ADV7535 also provides an audio input port,
    which supports the insertion of audio into the HDMI stream.

compatible: "adi,adv7535"

include: mipi-dsi-device.yaml

properties:
  reg:
    description:
      MIPI DSI virtual channel number used to communicate with the bridge.

  edid-addr:
    type: int
    default: 0x3f
    description: Optional EDID I2C address. If not set assumes 0x3f.

  packet-addr:
    type: int
    default: 0x38
    description: Optional packet I2C address. If not set assumes 0x38.

  cec-addr:
    type: int
    default: 0x3c
    description: Optional CEC I2C address. If not set assumes 0x3c.

  fixed-addr:
    type: int
    default: 0x00
    description: This should be set to a non-conflicting I2C address. By default set to 0x00.

  data-lanes:
    type: array
    required: true
    description:
      Number of data lanes.

  pixel-format:
    type: int
    required: true
    description:
      Pixel format. Available formats in dt-bindings/mipi_dsi/mipi_dsi.h.

  i2c:
    type: phandle
    required: true
    description:
      I2C controller used to access the bridge registers.

  i2c-addr:
    type: int
    required: true
    enum:
      - 0x39
      - 0x3d
    description: |
      Main register map I2C address. The address is 0x39 when PD/AD is pulled
      low and 0x3d when PD/AD is pulled high as power is applied. Wait 200 ms
      after the power supplies become stable before communicating with the
      ADV7535 over I2C.

  hactive:
    type: int
    required: true
    description: Horizontal active video area in pixels.

  hsync:
    type: int
    required: true
    description: Horizontal sync pulse width in pixels.

  hfp:
    type: int
    required: true
    description: Horizontal front porch width in pixels.

  hbp:
    type: int
    required: true
    description: Horizontal back porch width in pixels.

  vactive:
    type: int
    required: true
    description: Vertical active video area in lines.

  vsync:
    type: int
    required: true
    description: Vertical sync pulse width in lines.

  vfp:
    type: int
    required: true
    description: Vertical front porch height in lines.

  vbp:
    type: int
    required: true
    description: Vertical back porch height in lines.

  pd-gpios:
    type: phandle-array
    description: |
      GPIO connected to the PD/AD power-down pin. The pin level when the
      ADV7535 power supplies are applied selects both the main I2C address and
      the power-down polarity. A low level selects address 0x39 and active-high
      power-down, while a high level selects address 0x3d and active-low
      power-down. The GPIO flags must match the selected power-down polarity.
      Although this GPIO is optional, connecting it is strongly recommended
      because toggling the PD/AD pin resets more registers than a
      register-based reset. The I2C address and power-down polarity are sampled
      when power is applied. To change either setting, set the pin to the
      desired level and power-cycle the board.

  int-gpios:
    type: phandle-array
    required: true
    description: |
      Interrupt pin of ADV7535, active-low.
      If connected directly to the MCU,
      should be configured as open-drain, active-low.
```
