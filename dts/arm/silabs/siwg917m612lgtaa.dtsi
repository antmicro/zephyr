/*
 * Copyright (c) 2023 Antmicro <www.antmicro.com>
 *
 * SPDX-License-Identifier: Apache-2.0
 */

#include <mem.h>
#include <silabs/siwg917.dtsi>

/ {
	soc {
		compatible = "silabs,siwg917m612lgtaa", "silabs,siwg917", "silabs,siwx917",
			"simple-bus";
	};
};
