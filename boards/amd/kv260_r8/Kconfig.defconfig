## boards/amd/kv260_r8/Kconfig.defconfig
```kconfig
# Copyright (c) 2022 Linaro.
# Copyright (c) 2024 Antmicro <www.antmicro.com>
# SPDX-License-Identifier: Apache-2.0

if BOARD_KV260_R8

config BUILD_OUTPUT_BIN
	default y

if USERSPACE

config COMPILER_ISA_THUMB2
	default n

endif

endif # BOARD_KV260_R8
```

## boards/arm/kv260_r8/Kconfig.board
```kconfig
# Copyright (c) 2022 Linaro.
# Copyright (c) 2024 Antmicro <www.antmicro.com>
# SPDX-License-Identifier: Apache-2.0

config BOARD_KV260_R8
	bool "Xilinx KV260 development board R8-core"
	depends on SOC_XILINX_ZYNQMP_RPU_R8
```

## boards/arm/kv260_r8/Kconfig.defconfig
```kconfig
# Copyright (c) 2022 Linaro.
# Copyright (c) 2024 Antmicro <www.antmicro.com>
# SPDX-License-Identifier: Apache-2.0

if BOARD_KV260_R8

config BUILD_OUTPUT_BIN
	default y

config BOARD
	default "board_kv260_r8"

if USERSPACE

config COMPILER_ISA_THUMB2
	default n

endif

endif # BOARD_KV260_R8
```

## boards/arm/quick_feather/Kconfig.defconfig
```kconfig
# QuickLogic Quick Feather board

# Copyright (c) 2020 Antmicro <www.antmicro.com>
# SPDX-License-Identifier: Apache-2.0

if BOARD_QUICK_FEATHER

config BOARD
	default "quick_feather"

if PWM

config PWM_LITEX
	select SOC_EOS_S3_FPGA
	default n

config EOS_S3_PWM
	select EOS_S3_PROGRAM_FPGA
	default y

endif # PWM

if FLASH

config SPI
	default y

config SPI_NOR
	default y

config FLASH_HAS_PAGE_LAYOUT
	default y

config SPI_NOR_FLASH_LAYOUT_PAGE_SIZE
	default 32768

endif # FLASH

endif # BOARD_QUICK_FEATHER
```

## boards/arm/siwg917_brd4338a/Kconfig
```kconfig
# Copyright (c) 2023 Antmicro <www.antmicro.com>
#
# SPDX-License-Identifier: Apache-2.0

if BOARD_SIWG917_BRD4338A

module = BOARD_SIWG917
module-str = Board Control
source "subsys/logging/Kconfig.template.log_config"

endif # BOARD_SIWG917_BRD4338a
```

## boards/arm/siwg917_brd4338a/Kconfig.board
```kconfig
# Copyright (c) 2023 Antmicro <www.antmicro.com>
#
# SPDX-License-Identifier: Apache-2.0

config BOARD_SIWG917_BRD4338A
	bool "Silicon Labs BRD4338A"
	depends on SOC_SERIES_SIWG917
	select SOC_PART_NUMBER_SIWG917M612LGTAA
```

## boards/arm/siwg917_brd4338a/Kconfig.defconfig
```kconfig
# Copyright (c) 2023 Antmicro <www.antmicro.com>
#
# SPDX-License-Identifier: Apache-2.0

if BOARD_SIWG917_BRD4338A

config BOARD
	default "siwg917_brd4338a"

if BT

config MAIN_STACK_SIZE
	default 2304

choice BT_HCI_BUS_TYPE
	default BT_SIWG917
endchoice

config HEAP_MEM_POOL_SIZE
	default 1024

config COMMON_LIBC_MALLOC_ARENA_SIZE
	default 4096

config NUM_PREEMPT_PRIORITIES
	default 56

config SYS_CLOCK_TICKS_PER_SEC
	default 1000

config CMSIS_V2_THREAD_MAX_STACK_SIZE
	default 2048

config CMSIS_V2_THREAD_DYNAMIC_MAX_COUNT
	default 10

config CMSIS_V2_THREAD_DYNAMIC_STACK_SIZE
	default 2048

endif # BT

if WIFI

config NUM_PREEMPT_PRIORITIES
	default 56

config SYS_CLOCK_TICKS_PER_SEC
	default 1000

config CMSIS_V2_THREAD_MAX_STACK_SIZE
	default 2048

config CMSIS_V2_THREAD_DYNAMIC_MAX_COUNT
	default 10

config CMSIS_V2_THREAD_DYNAMIC_STACK_SIZE
	default 2048

config COMMON_LIBC_MALLOC_ARENA_SIZE
	default 4096

config NET_MGMT_EVENT_QUEUE_SIZE
	default 10

endif # WIFI

endif # BOARD_SIWG917_BRD4338A
```

## boards/arm/siwg917_brd4338a/siwg917_brd4338a_defconfig
```kconfig
# Copyright (c) 2023 Antmicro <www.antmicro.com>
# SPDX-License-Identifier: Apache-2.0

CONFIG_SOC_SERIES_SIWG917=y
CONFIG_BOARD_SIWG917_BRD4338A=y
CONFIG_SYS_CLOCK_HW_CYCLES_PER_SEC=32000000
CONFIG_FLASH_BASE_ADDRESS=0x8212000

CONFIG_CONSOLE=y
CONFIG_UART_CONSOLE=y
CONFIG_SERIAL=y
CONFIG_PINCTRL=y
```

## drivers/i2c/Kconfig.siwx917
```kconfig
# Copyright (c) 2024 Antmicro <www.antmicro.com>
#
# SPDX-License-Identifier: Apache-2.0

config I2C_SIWX917
	bool "SiLabs SiWx917 I2C driver"
	default y
	depends on DT_HAS_SILABS_SIWX917_I2C_ENABLED
	help
	  Enable the driver for the SiLabs SiWx917 SoC I2C.
```

## drivers/led/Kconfig.eos_s3_1
```kconfig
# Copyright (c) 2018 Workaround GmbH
# SPDX-License-Identifier: Apache-2.0

config EOS_S3_LED1
	bool "EOS S3 LED driver 1"
	help
	  Enable LED driver 1 for QL S3.
```

## drivers/led/Kconfig.eos_s3_basic
```kconfig
# Copyright 2020 QuickLogic
# Licensed under the Apache License, Version 2.0 

config EOS_S3_LED_BASIC
	bool "EOS S3 basic LED driver"
	help
	  Enable basic LED driver for QL S3.
```

## drivers/pinctrl/Kconfig.siwx917
```kconfig
# Copyright (c) 2023 Antmicro <www.antmicro.com>
# SPDX-License-Identifier: Apache-2.0

config PINCTRL_SILABS_SIWX917
	bool "SiLabs SiWx917 SoC series pinctrl driver"
	default y
	depends on DT_HAS_SILABS_SIWX917_PINCTRL_ENABLED
	help
	  Enable the pinctrl driver for the SiLabs SiWx SoC series.
```

## drivers/pwm/Kconfig.eos_s3
```kconfig
# Copyright 2020 QuickLogic
# Licensed under the Apache License, Version 2.0 

menuconfig EOS_S3_PWM
	bool "EOS S3 LiteX PWM driver"
	depends on HAS_DTS
	help
	  Set if PWM IP generated with EOS S3 tools

if EOS_S3_PWM

config PWM_LITEX_INIT_PRIORITY
	int "Init priority"
	default 70
	help
	  PWM device driver initialization priority.

endif # PWM_LITEX
```

## drivers/spi/Kconfig.siwx917
```kconfig
# Silicon Labs SiWx917 SPI
#
# Copyright (c) 2024 Antmicro <www.antmicro.com>
#
# SPDX-License-Identifier: Apache-2.0
#

config SPI_SIWX917
	bool "Silicon Labs SiWx917 SPI driver"
	default y
	depends on DT_HAS_SILABS_SIWX917_SPI_ENABLED
	help
	  Enable driver for Slicon Labs SiWx917 SoC SPI.
```

## drivers/wifi/siwg917/Kconfig.siwg917
```kconfig
# Copyright (c) 2023 Antmicro <www.antmicro.com>
#
# SPDX-License-Identifier: Apache-2.0

menuconfig WIFI_SIWG917
	bool "SiWG917 SoC WiFi support"
	default y
	depends on DT_HAS_SILABS_SIWG917_WIFI_ENABLED
	select CMSIS_RTOS_V2
	select THREAD_NAME
	select THREAD_STACK_INFO
	select THREAD_MONITOR
	select INIT_STACKS
	select WIFI_OFFLOAD
	select NET_L2_WIFI_MGMT
	help
	  Enable SiWG917 SoC WiFi support.

if WIFI_SIWG917

config NET_TCP_WORKQ_STACK_SIZE
	default 2048

config SIWG917_AP_MODE
	bool "Wifi Access Point mode"

config SIWG917_CLIENT_MODE
	bool "Wifi Client mode"
	default y

config NET_RX_STACK_SIZE
	default 2048

config NET_MGMT_EVENT_STACK_SIZE
	default 2048

config WIFI_SIWG917_MAX_PACKET_SIZE
	int "Maximum size of a packet, in bytes"
	default 1400

config WIFI_SIWG91_OFFLOAD_MAX_SOCKETS
	int "Maximum number of sockets that can be managed"
	default 10

endif # WIFI_SIWG917
```

## dts/bindings/i2c/silabs,siwx917-i2c.yaml
```yaml
# Copyright (c) 2024 Antmicro <www.antmicro.com>
#
# SPDX-License-Identifier: Apache-2.0

description: SiLabs SiWx917 I2C

compatible: "silabs,siwx917-i2c"

include: [i2c-controller.yaml, pinctrl-device.yaml]

properties:
  reg:
    required: true

  interrupts:
    required: true
```

## dts/bindings/pinctrl/silabs,siwx917-pinctrl.yaml
```yaml
# Copyright (c) 2023 Antmicro <www.antmicro.com>
# SPDX-License-Identifier: Apache-2.0

description: |
  The SiLabs SiWx917 pin controller is a devicetree node tasked with selecting the proper IO
  function for a given pin.

  Create this node in the SoC devicetree as follows:

    pinctrl0: pinctrl {
      compatible = "silabs,siwx917-pinctrl";
    };

  This node expects a vector of three values:
    - Port number
    - Pin number
    - Mux (IO function)

  Create a configuration by referencing the 'pinctrl' node:

    &pinctrl0 {
      group1: group1 {
        pinmux = <0 29 2>;
      };
    };

compatible: "silabs,siwx917-pinctrl"

include: base.yaml

child-binding:
  description: |
    This binding gives a base representation of the SiLabs SiWx917 pins configuration.

  properties:
    pinmux:
      required: true
      type: array
      description: |
        SiLabs SiWx917 pin configuration (port, pin, mux).
```

## dts/bindings/spi/silabs,siwx917-spi.yaml
```yaml
# Copyright (c) 2024 Antmicro <www.antmicro.com>
# SPDX-License-Identifier: Apache-2.0

description: Silicon Labs SiWx917 SPI

compatible: "silabs,siwx917-spi"

include: [spi-controller.yaml, pinctrl-device.yaml]

properties:
  reg:
    required: true
  intf_pll_clk:
    required: true
    type: int
  intf_pll_ref_clk:
    required: true
    type: int
  soc_pll_clk:
    required: true
    type: int
  soc_pll_ref_clk:
    required: true
    type: int
  intf_pll_500_control_value:
    required: true
    type: int
  soc_pll_mm_count_limit:
    required: true
    type: int
  division_factor:
    required: true
    type: int
  swap_read_data:
    required: true
    type: int
  swap_write_data:
    required: true
    type: int
  gspi_bitrate:
    required: true
    type: int
  gspi_bit_width:
    required: true
    type: int
```

## dts/bindings/wifi/silabs,siwg917-wifi.yaml
```yaml
# Copyright (c) 2023 Antmicro <www.antmicro.com>
#
# SPDX-License-Identifier: Apache-2.0

description: SiLabs SiWG917 SoC WiFi

compatible: "silabs,siwg917-wifi"
```

## modules/Kconfig.silabs
```kconfig
# Gecko SDK

# Copyright (c) 2017, Christian Taedcke
# Copyright (c) 2023 Antmicro <www.antmicro.com>
# SPDX-License-Identifier: Apache-2.0

config HAS_SILABS_GECKO
	bool
	select HAS_CMSIS_CORE
	depends on SOC_FAMILY_EXX32

config HAS_SILABS_WISECONNECT
	bool
	select HAS_CMSIS_CORE
	depends on SOC_FAMILY_SIWX917
```

## samples/drivers/led_eos_s3_1/sample.yaml
```yaml
sample:
  description: Demonstration of the eos_s3_1 LED driver
  name: led_eos_s3_1 sample
tests:
  sample.drivers.led.eos_s3_1:
    platform_whitelist: quick_feather
    tags: led
    harness: TBD
```

## samples/drivers/led_eos_s3_basic/sample.yaml
```yaml
sample:
  description: Demonstration of the eos_s3 basic LED driver
  name: led_eos_s3_basic sample
tests:
  sample.drivers.led.eos_s3_basic:
    platform_whitelist: quick_feather
    tags: led
    harness: TBD
```
