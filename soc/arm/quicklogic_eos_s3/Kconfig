## soc/arm/quicklogic_eos_s3/Kconfig
```kconfig
# Copyright (c) 2020 Antmicro <www.antmicro.com>
# SPDX-License-Identifier: Apache-2.0

config SOC_EOS_S3
	bool

config SOC_EOS_S3_GPIO
       bool
       help
         Set if the General Purpose Input/Output (GPIO) HAL module is used.

config SOC_EOS_S3_FPGA
       bool
       help
         Enable on chip FPGA

config EOS_S3_PROGRAM_FPGA
	bool
	help
	  Enable programming the FPGA IP on EOS S3
```

## soc/arm/quicklogic_eos_s3/Kconfig.defconfig
```kconfig
# Copyright (c) 2020 Antmicro <www.antmicro.com>
# SPDX-License-Identifier: Apache-2.0

if SOC_EOS_S3

config SOC
	default "quicklogic_eos_s3"

config NUM_IRQS
	default 52

config SYS_CLOCK_HW_CYCLES_PER_SEC
	default 61440000

if SERIAL

config UART_PL011
	default y

config UART_LITEUART
	select SOC_EOS_S3_FPGA
	default n

if UART_PL011

config UART_INTERRUPT_DRIVEN
	default y

config UART_PL011_PORT0
	default y

config UART_PL011_PORT1
	default n

endif # UART_PL011

if UART_LITEUART

config UART_INTERRUPT_DRIVEN
	default n

endif # UART_LITEUART

endif # SERIAL

if GPIO

config GPIO_EOS_S3
	default y

endif # GPIO

if SPI

config SPI_EOS_S3
	default y

endif # SPI

if LED
config EOS_S3_LED_BASIC
	select EOS_S3_PROGRAM_FPGA
	default y
endif # LED

endif # SOC_EOS_S3
```

## soc/arm/silabs_siwx917/Kconfig
```kconfig
# Copyright (c) 2023 Antmicro <www.antmicro.com>
#
# SPDX-License-Identifier: Apache-2.0

config SOC_FAMILY_SIWX917
	bool

if SOC_FAMILY_SIWX917

config SOC_FAMILY
	string
	default "silabs_siwx917"

source "soc/arm/silabs_siwx917/*/Kconfig.soc"

endif # SOC_FAMILY_SIWX917
```

## soc/arm/silabs_siwx917/Kconfig.defconfig
```kconfig
# Copyright (c) 2023 Antmicro <www.antmicro.com>
#
# SPDX-License-Identifier: Apache-2.0

if SOC_FAMILY_SIWX917

source "soc/arm/silabs_siwx917/*/Kconfig.defconfig.series"

endif # SOC_FAMILY_SIWX917
```

## soc/arm/silabs_siwx917/Kconfig.soc
```kconfig
# Copyright (c) 2023 Antmicro <www.antmicro.com>
#
# SPDX-License-Identifier: Apache-2.0

source "soc/arm/silabs_siwx917/*/Kconfig.series"
```

## soc/arm/silabs_siwx917/siwg917/Kconfig.defconfig.series
```kconfig
# Silicon Labs SiWG917 MCU configuration options

# Copyright (c) 2023 Antmicro <www.antmicro.com>
#
# SPDX-License-Identifier: Apache-2.0

if SOC_SERIES_SIWG917

config SOC_SERIES
	default "siwg917"

config SOC_PART_NUMBER
	default "siwg917m612lgtaa" if SOC_PART_NUMBER_SIWG917M612LGTAA

config NUM_IRQS
	default 99

source "soc/arm/silabs_siwx917/siwg917/Kconfig.defconfig.siwg917"

endif # SOC_SERIES_SIWG917
```

## soc/arm/silabs_siwx917/siwg917/Kconfig.series
```kconfig
# Copyright (c) 2023 Antmicro <www.antmicro.com>
#
# SPDX-License-Identifier: Apache-2.0

config SOC_SERIES_SIWG917
	bool "SiWG917 series MCU"
	select ARM
	select CPU_CORTEX_M4
	select CPU_HAS_FPU
	select SOC_FAMILY_SIWX917
	select HAS_SILABS_WISECONNECT
	help
	  Enable support for the SiWG917 MCU series
```

## soc/arm/silabs_siwx917/siwg917/Kconfig.soc
```kconfig
# Copyright (c) 2023 Antmicro <www.antmicro.com>
#
# SPDX-License-Identifier: Apache-2.0

config SOC_PART_NUMBER_SIWG917M612LGTAA
	bool
	depends on SOC_SERIES_SIWG917
```

## soc/arm/xilinx_zynqmp_r8/Kconfig
```kconfig
# Copyright (c) 2019 Stephanos Ioannidis <root@stephanos.io>
# Copyright (c) 2024 Antmicro <www.antmicro.com>
# SPDX-License-Identifier: Apache-2.0

config SOC_XILINX_ZYNQMP_R8
	bool
```

## soc/xlnx/zynqmp_r8/Kconfig
```kconfig
# Copyright (c) 2019 Lexmark International, Inc.
# Copyright (c) 2019 Stephanos Ioannidis <root@stephanos.io>
# Copyright (c) 2024 Antmicro <www.antmicro.com>
# SPDX-License-Identifier: Apache-2.0

config SOC_XILINX_ZYNQMP_RPU_R8
	select ARM
	select CPU_CORTEX_R8
	select PLATFORM_SPECIFIC_INIT
	select CPU_HAS_ARM_MPU
	select VFP_DP_D16
```

## soc/xlnx/zynqmp_r8/Kconfig.soc
```kconfig
# Copyright (c) 2019 Lexmark International, Inc.
# Copyright (c) 2019 Stephanos Ioannidis <root@stephanos.io>
# Copyright (c) 2024 Antmicro <www.antmicro.com>
# SPDX-License-Identifier: Apache-2.0

config SOC_XILINX_ZYNQMP_R8
	bool

config SOC_XILINX_ZYNQMP_RPU_R8
	bool
	select SOC_XILINX_ZYNQMP_R8
	help
	  Xilinx ZynqMP RPU R8

config SOC_FAMILY
	default "xilinx_zynqmp_r8" if SOC_XILINX_ZYNQMP_R8

config SOC
	default "zynqmp_rpu_r8" if SOC_XILINX_ZYNQMP_RPU_R8
```
